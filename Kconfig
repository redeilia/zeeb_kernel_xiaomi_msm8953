## Kconfig
```kconfig
#
# For a description of the syntax of this configuration file,
# see Documentation/kbuild/kconfig-language.txt.
#
mainmenu "Linux/$ARCH $KERNELVERSION Kernel Configuration"

config ARCH_QCOM
	bool "Qualcomm Platforms"
	select PINCTRL

config RDSP_QCOM
	bool "RSDP Qualcomm Platforms"
	select PINCTRL

config SRCARCH
	string
	option env="SRCARCH"

source "arch/$SRCARCH/Kconfig"
```
